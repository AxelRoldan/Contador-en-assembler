			#INCLUDE<P16F628.INC>
		__CONFIG 3F10
		
;DECLARACION DE ESPACIOS DE MEMORIA A USAR		
		CBLOCK	0X20
		D1
		D2
		D3
		D4
		AUX_W
		AUX_STATUS
		CONT_AR	
		CONT_AR_2
        D1_AUX
        D2_AUX
        D3_AUX
        D4_AUX
        CONT_CALC
		ENDC		

;DECLARACION DE CONSTATNES
#DEFINE BTN_G1 	PORTA,6
#DEFINE BTN_G2 	PORTA,7
#DEFINE BTN_R 	PORTA,4
#DEFINE BTN_M 	PORTB,0

#DEFINE PIN_D1 	3
#DEFINE PIN_D2 	2
#DEFINE PIN_D3 	1
#DEFINE PIN_D4 	0

#DEFINE	CTRL_DISPLAY	PORTA
#DEFINE	APAGAR_DISPLAYS CLRF	PORTA

;DECLARACION DE MACROS
;MACRO MOSTRAR MUESTRA LOS VALORES DE CADA UNIDAD
MOSTRAR	MACRO	 DIGITO,PIN
		APAGAR_DISPLAYS
		MOVF	DIGITO,W
		CALL	TAB_DISPLAY
		MOVWF	PORTB
		BSF		CTRL_DISPLAY,PIN
		ENDM
;MACRO VERIFICAR: HACE EL CALCULO PARA SABER SI EL NUMERO ES MAYOR A 10 O MENOR
VERIFICAR MACRO DIGITO,DIGITO_AUX
          
         MOVF     DIGITO_AUX,0         ;MOVEMOS EL AUXILIAR A LA ESTACION DE TRABAJO
         ADDWF    DIGITO,1             ;SE LO SUMAMOS AL DIGITO ENCARGADO DE MOSTRAR EL NUMERO
         MOVLW    .10                  ;MOVEMOS UN 10 A LA ESTACION DE TRABAJO
         SUBWF    DIGITO,1             ;RESTAMOS EL VALOR DEL DIGITO-(10)
         ENDM                          ;FIN MACRO

;MACRO PARA SUMAR LOS NUMEROS CONTIENE VARIOS CALL CREEMOS QUE ES INEFICIENTE PERO ASI SALIO
         
SUMAR 	MACRO	
               ;IR A LOS CALL PARA VER COMO SE MANIPULAN LOS DATOS
		       CALL SUMAR_3           ;1-AUMENTA 1,SI EL DIGITO LLEGA A 10 Z SE LEVANTA
               BTFSS STATUS,Z         ;2-SI Z SE LEVANTA HACE LA SUMA DEL SIGUIENTE DIGITO 
               GOTO RETORNO_0         ;3-SI NO SE LEVANTA SALTA AL FINAL DE LA MACRO
               BCF STATUS,Z           ;4-PARA HACER LA SUMA DEL OTRO DIGITO RESETEAMOS LA BANDERA Z
               CALL SUMAR_4           ;SE REPITE EL PROCESO DEL 1 AL 4
               BTFSS STATUS,Z
               GOTO RETORNO_0
               BCF STATUS,Z
               CALL SUMAR_2
               BTFSS STATUS,Z
               GOTO RETORNO_0
               BCF STATUS,Z
               CALL SUMAR_1
               BCF STATUS,Z
          
RETORNO_0                             ;ETIQUETA RETORNO_0 SI EL DIGITO NO LLEGA A 10 SALTA ACA
          	ENDM                      ;FIN MACRO


;MACRO PARA DECREMENTAR EL DIGITO
DECRECER        MACRO                 ;COMIENZO MACRO
               ;IR A LOS CALL PARA VER COMO SE MANIPULAN LOS DATOS
               CALL RESTAR_3          ;1-DECRECEMOS EL DIGITO SI LLEGA A -1 Y LE SUMAMOS 1 Z SE LEVANTA
               BTFSS STATUS,Z         ;2-PREGUNTAMOS SI LA BANDERA SE LEVANTO PARA SABER SI EL DIGITO LLEGO A 0
               GOTO RETORNO_1         ;3-SI Z NO SE LEVANTA SALTAMOS AL FINAL DE LA MACRO, HACIA LA ETIQUETA RETORNO_1
               CALL RESTAR_4          ;SE REPITE EL PROCESO DEL 1 AL 3
               BTFSS STATUS,Z
               GOTO RETORNO_1
               BCF STATUS,Z
               CALL RESTAR_2
               BTFSS STATUS,Z
               GOTO RETORNO_1
               BCF STATUS,Z
               CALL RESTAR_1
               BCF STATUS,Z
               BCF STATUS,Z
              
RETORNO_1                             ;ETIQUETA RETORNO_1 SI EL DIGITO ANALIZADO EN ESE MOMENTO AL SUMARLE 1 NO LLEGA A 0 SALTA HACIA ACA 
          	ENDM                      ;FIN MACRO


;INICIO DEL PROGRAMA		
		
		ORG		0X00
		GOTO	CONFI
		ORG		0X04		

;RUTINA DE INTERRUPCION
;DESBORDA EL TIMER CADA 5ms
;MUESTRA TODOS LOS DIGITOS DE ACUERDO A LAS VARIABLES D1:4

;GUARDA STATUS Y W EN VARIABLES AUXILIARES
		BCF		INTCON,T0IF
		BCF		INTCON,GIE		
		MOVWF	AUX_W
		MOVLW	STATUS
		MOVWF	AUX_STATUS
;MULTIPLEXADO DE DISPLAYS
		BTFSC	CTRL_DISPLAY,PIN_D1
		GOTO	MOSTRAR_D2			
		BTFSC	CTRL_DISPLAY,PIN_D2
		GOTO	MOSTRAR_D3
		BTFSC	CTRL_DISPLAY,PIN_D3
		GOTO	MOSTRAR_D4
;MUESTRA LOS VALORES DE LOS PINS CORRESPONDIENTES		
        MOSTRAR	D1,PIN_D1
		GOTO 	FIN_T0I

MOSTRAR_D2
		MOSTRAR D2,PIN_D2
		GOTO 	FIN_T0I

MOSTRAR_D3
		MOSTRAR D3,PIN_D3
		GOTO 	FIN_T0I

MOSTRAR_D4
		MOSTRAR	D4,PIN_D4
		
FIN_T0I ;FINAL DE LA INTERRUPCION
;REINICIA TIMER Y RECUPERA STATUS Y W
		MOVLW	.236
		MOVWF	TMR0
		MOVF	AUX_STATUS,W
		MOVWF	STATUS
		MOVF	AUX_W,W
		RETFIE

;CONFIGURACION
		
CONFI
		MOVLW	0X07
		MOVWF	CMCON; CMCON SE TIENE QUE ESTABLECER EN 7 PARA USAR TODO EL PORTA
		MOVLW	.236
		MOVWF	TMR0
		BSF		STATUS,RP0
		MOVLW	b'00000001'
		MOVWF	TRISB	
		MOVLW	b'11110000'
		MOVWF	TRISA
		BCF		OPTION_REG,T0CS
		BCF		OPTION_REG,PSA
		BSF		OPTION_REG,PS0
		BSF		OPTION_REG,PS1
		BSF		OPTION_REG,PS2
		BSF		INTCON,GIE
		BSF		INTCON,T0IE
		BCF		STATUS,RP0

;RUTINA PRINCIPAL
;INCREMENTA DE 0 A 9 CADA DIGITO DEPENDIENDO QUE BOT?N SE TOCA.
        CLRF    CONT_CALC       
       	CLRF	D1_AUX          ;LIMPIAMOS TODAS LAS VARIABLES
		CLRF	D2_AUX
		CLRF	D3_AUX
		CLRF	D4_AUX
        MOVLW   .2              ;MOVEMOS UN 2 A LA ESTACION A LA ESTACION DE TRABAJO PARA MOVERLO A LA VARIABLE CONT_CALC
        MOVWF   CONT_CALC       ;CONTADOR SI LLEGA A 0 SALTAMOS LA INSTRUCCION //VER BOTONES PARA VER SU MANIPULACION
REINICIO                        
        ;SI QUEREMOS REINICIAR LOS NUMEROS EL PROGRAMA VIENE HACIA ACA
		CLRF	PORTA           ;LIMPIEZA DE TODAS LAS VARIABLES PARA QUE ESTEN A 0
		CLRF	PORTB
		CLRF	D1              ;MILESIMA
		CLRF	D2              ;CENTENA
		CLRF	D3              ;UNIDAD
		CLRF	D4              ;DECENA

BOTONES                         ;----------------------------------------------------------------------|>BTN_G1
                                ;BOTON PARA INCREMENTAR                                          
		BTFSC   BTN_G1          ;SI LO PRECIONARON ENTRA POR ACA PARA GENERAR LA DEMORA
        BTFSC	BTN_G1          ;LUEGO ENTRA A LA MACRO DEMORA
		CALL	DEMORA_AR       ;MACRO SUMAR AUMENTA LOS DIGITOS UNA VEZ POR UNIDAD LOS DIGITOS
		BTFSC	BTN_G1          ;----------------------------------------------------------------------|>BTN_G2
	 	SUMAR                   ;BOTON PARA DECRECER                                             
        BTFSC   BTN_G2          ;GENERAMOS LA DEMORA Y PASAMOS A DECRECER
        CALL    DEMORA_AR       ;ENTRA A LA MACRO DECRECER PARA DECRECER
        BTFSC   BTN_G2          ;----------------------------------------------------------------------|>BTN_R
        DECRECER                ;BOTON PARA REINICIAR LOS NUMEROS                                
        BTFSC   BTN_R           ;BUSCA LA ETIQUETA REINICIO PARA LIMPIAR TODAS LAS VARIABLES
        GOTO    REINICIO        ;----------------------------------------------------------------------|>BTN_M
        BTFSC   BTN_M           ;GUARDA VARIABLES Y LUEGO HACE LA SUMA                            
        DECFSZ  CONT_CALC       ;REDUCIMOS EL CONTADOR CONT_CALC=2 EN UNIDA UNIDAD, QUEREMOS QUE GUARDE 
        GOTO    SALTO           ;LAS VARIABLES EN VARIABLES AUXILIARES AHORA CONT_CALC=1
        GOTO    CONDICIONAL     ;SI EL CONTADOR LLEGA A 0 AL APRETARLO DOS VECES HACE UN SALTO
SALTO   BTFSC   BTN_M           ;GENERAMOS UNA PEQUEСA DEMORA
        CALL    CARGAR_AUX      ;GENERAMOS UNA LLAMADA PARA HACER LA SUMA
		GOTO 	BOTONES         ;AL FINAL UNA VEZ HECHA LA SUMA REINICIAMOS EL CONTADOR AL VALOR 
                                ;ORIGINAL EN ESTE CASO TENIA UN 2
CONDICIONAL                     ;-----------------------------------------------------------------------
        CALL    DEMORA_AR
        CALL    CALCULO_1
        MOVLW   .2
        MOVWF   CONT_CALC
        GOTO    BOTONES
        

;LLAMADA QUE HACE LA DEMORA
DEMORA_AR
		MOVLW	.255
		MOVWF	CONT_AR
LOOP_AR
		MOVLW	.255
		MOVWF	CONT_AR_2
LOOP_AR_2
		DECFSZ	CONT_AR_2,1
		GOTO	LOOP_AR_2
		DECFSZ	CONT_AR,1
		GOTO	LOOP_AR
		RETURN
; LLAMADAS DE LAS SUBRUTINAS Y TODAS FUNCIONAN IGUAL
SUMAR_1        
        INCF	D1,1             ;INCREMENTAMOS EL DIGITO Y LO GUARDAMOS EN SU DIRRECION ACTUAL
		MOVF	D1,W             ;AHORA LO MOVEMOS EN LA ESTACION DE TRABAJO AMBAS CONSERVAN EL MISMO VALOR 
 		XORLW	.10              ;SI EL DIGITO QUE AUMENTAMOS LLEGA A 10 LO ANALIZAMOS EN LA ESTACION DE TRABAJO
		BTFSC	STATUS,Z         ;SI CONTIENE 10 LA VARIABLE, XORLW LEVANTA FLAG Z Y PODEMOS PROCEDER A LIMPIAR EL DIGITO
		CLRF	D1               ;SI NO ES ASI SIMPLEMENTE TERMINA LA SUBRUTINA

        RETURN                   ;FIN SUBRUTINA //TODOS LOS SUMAR FUNCIONAN DE LA MISMA MANERA

SUMAR_2        
        INCF	D2,1
		MOVF	D2,W
		XORLW	.10
		BTFSC	STATUS,Z
		CLRF	D2

        RETURN

SUMAR_3        
        INCF	D3,1
		MOVF	D3,W
		XORLW	.10
		BTFSC	STATUS,Z
		CLRF	D3

        RETURN


SUMAR_4        
        INCF	D4,1
		MOVF	D4,W
		XORLW	.10
		BTFSC	STATUS,Z
		CLRF	D4

        RETURN
;SUBRUTINAS QUE RESTAN EL DIGITO CORRESPONDIENTE ENTRA EN FUNCION CON LA MACRO DECRECER //TODOS LOS RESTAR FUNCIONAN IGUAL
RESTAR_1        
        DECF	D1,1              ;RESTAMOS 1 AL DIGITO
        MOVF    D1,0              ;LO MOVEMOS A LA ESTACION DE TRABAJO Y SI HAY UN -1
        ADDLW   .1                ;EN LA ESTACION AL SUMARLE UN 1 SE PRODUCE ACARREO 
		BTFSS	STATUS,C          ;FLAG C SE LEVANTA Y HACEMOS SALTO CONDICIONAL,PERO SI NO HAY UN -1 TERMINA LA RUTINA
        RETURN                   
        CLRF    D2                ;LIMPIAMOS EL DIGITO QUE HABIA LLEGADO A -1
		MOVLW  .9                 ;Y MOVEMOS UN LITERAL A LA ESTACION EN ESTE CASO UN 9
        ADDWF D1                  ;Y SE LO SUMAMOS AL DIGITO
        BSF STATUS,Z              ;PONEMOS A 1 EL FLAG Z PARA QUE DESCRESCA LOS DEMAS NUMEROS
        RETURN                    ;FIN SUBRUTINA

RESTAR_2        
        DECF	D2,1
        MOVF    D2,0
        ADDLW   .1
		BTFSS	STATUS,C
        RETURN
        CLRF    D2
		MOVLW  .9
        ADDWF D2
        BSF STATUS,Z

RESTAR_3        
        DECF	D3,1
        MOVF    D3,0
        ADDLW   .1
		BTFSS	STATUS,C
        RETURN
        CLRF    D3
		MOVLW  .9
        ADDWF D3
        BSF STATUS,Z
        RETURN


RESTAR_4        
        DECF	D4,1
        MOVF    D4,0
        ADDLW   .1
		BTFSS	STATUS,C
        RETURN
        CLRF    D4
		MOVLW  .9
        ADDWF D4
        BSF STATUS,Z
        RETURN

CARGAR_AUX                         ;CARGAMOS LAS VARIABLES AUXILIARES, SE LIMPIO LA ESTACION DE TRABAJO YA QUE DABA ERRORES
        MOVF D1,0                  ;MOVEMOS LOS DIGITOS A LA ESTACION DE TRABAJO Y LUEGO A SUS RESPECTIVOS AUXILIARES
        MOVWF D1_AUX               ;Y TERMINAMOS LIMPIANDO LA ESTACION DE TRABAJO
        CLRW
        MOVF D2,0
        MOVWF D2_AUX
        CLRW
        MOVF D3,0
        MOVWF D3_AUX
        CLRW
        MOVF  D4,0
        MOVWF D4_AUX
        CLRW
       	CLRF	PORTA              ;LIMPIAMOS LOS DIGITOS PARA PODER SER USADOS NUEVAMENTE
		CLRF	PORTB
		CLRF	D1
		CLRF	D2
		CLRF	D3
		CLRF	D4
   
        RETURN                     ;FIN SUBRUTINA



CALCULO_1                         ;LLAMADA CALCULO, SUMA DIGITO A DIGITO SI HAY UN ACARREO SE LO PASA AL OTRO DIGITO
        VERIFICAR D3,D3_AUX       ;MACRO PARA VERIFICAR SI  EL NUMERO ES MAYOR A 10 O MENOR
        BTFSC   STATUS,Z          ;DEPENDIENDO DEL RESULTADO QUE NOS DIO LA MACRO SEGUIMOS
        GOTO    ES_CERO_D3        ;SALTO CONDICIONALES 
        GOTO    NODA_CERO_D3
ES_CERO_D3                        ;SI ES CERO
        CALL    SUMAR_4           ;SE PRODUJO UN ACARREO ENTONCES LE SUMAMOS UN UNO AL NUMERO SIGUIENTE
        CLRF    D3                ;LIMPIAMOS EL DIGITO EN DONDE SE HIZO LA SUMA
        GOTO    FIN_MACRO         ;VAMOS AL FINAL DE LA MACRO
NODA_CERO_D3
        BTFSS   STATUS,C          ;SI NO DA CERO PREGUNTAMOS SI ES MAYOR A 10 O MENOR A 10 EL FLAG C NOS DIRA
        GOTO    MENOR_A10_D3
        GOTO    MAYOR_A10_D3
MENOR_A10_D3                      ;SI ES MENOR A 10  
        MOVLW   .10               ;LE SUMAMOS 10 PARA QUE EL NUMERO VUELVA A SU VALOR ORIGINAL YA QUE LE RESTAMOS 10
        ADDWF   D3,1              
        GOTO    FIN_MACRO                      
MAYOR_A10_D3
        CALL    SUMAR_4           ;SI ES MAYOR A 10 EL DIGITO CONSERVA SUS VALORES Y HACEMOS EL CARREO DEL SIGUIENTE DIGITO
FIN_MACRO 

        VERIFICAR D4,D4_AUX       ;ESTE PROCESO ES EL MISMO NO VERIFICAMOS SI DA CERO
        BTFSS   STATUS,C
        GOTO    MENOR_A10_D4
        GOTO    MAYOR_A10_D4
MENOR_A10_D4 
        MOVLW   .10
        ADDWF   D4,1
        GOTO    FIN_MACRO_1                   
MAYOR_A10_D4
        CALL    SUMAR_2
FIN_MACRO_1

        RETURN



;CONVERSOR A DISPLAY
;RB1->SEG A
;RB2->SEG B 
;RB3->SEG C
;RB4->SEG D
;RB5->SEG E 
;RB6->SEG F
;RB7->SEG G

TAB_DISPLAY
		ADDWF	PCL,1
		;         GFEDCBA-
		RETLW	b'01111111'	
		RETLW	b'00001101'
		RETLW	b'10110111'
		RETLW	b'10011111'
		RETLW	b'11001101'
		RETLW	b'11011011'
		RETLW	b'11111011'
		RETLW	b'00001111'
		RETLW	b'11111111'
		RETLW	b'11001111'
		
		END
